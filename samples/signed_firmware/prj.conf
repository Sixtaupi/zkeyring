## CMakeLists.txt
```
# SPDX-License-Identifier: Apache-2.0

cmake_minimum_required(VERSION 3.28.0)
find_package(Zephyr REQUIRED HINTS $ENV{ZEPHYR_BASE})
project(signed_firmware)

target_sources(app PRIVATE src/main.c)
```

## Kconfig.sysbuild
```
# SPDX-License-Identifier: Apache-2.0

# This default takes precedence over MCUboot's private development key.
config BOOT_SIGNATURE_KEY_FILE
	string
	default "$(APP_DIR)/keys/dev-public.pem" if BOOT_SIGNATURE_TYPE_ECDSA_P256

source "share/sysbuild/Kconfig"
```

## sample.yaml
```
# SPDX-License-Identifier: Apache-2.0

sample:
  name: Signed firmware
  description: MCUboot firmware signed with zkeyring
common:
  sysbuild: true
  tags:
    - mcuboot
    - signing
tests:
  # Signing is deferred, so this build needs no signing backend.
  sample.zkeyring.signed_firmware.deferred:
    build_only: true
    extra_args:
      - signed_firmware_CONFIG_ZSIGNING_DEFERRED=y
      - ZKEYRING_PROFILE=dev
    platform_allow:
      - qemu_cortex_m0
      - nrf52840dk/nrf52840
      - nucleo_g0b1re
    integration_platforms:
      - qemu_cortex_m0
      - nrf52840dk/nrf52840
      - nucleo_g0b1re
```

## sysbuild.conf
```
# SPDX-License-Identifier: Apache-2.0

SB_CONFIG_BOOTLOADER_MCUBOOT=y
SB_CONFIG_ZKEYRING_SIGNATURE_ECDSA_P256=y
SB_CONFIG_MCUBOOT_MODE_OVERWRITE_ONLY=y
SB_CONFIG_ZKEYRING_PROFILE_PUBLIC_KEY=y
```

## prj.conf
```kconfig
# SPDX-License-Identifier: Apache-2.0

CONFIG_ZSIGNING=y
CONFIG_ZSIGNING_PROFILE="local"
```

## release.conf
```kconfig
# SPDX-License-Identifier: Apache-2.0

CONFIG_ZSIGNING=y
CONFIG_ZSIGNING_PROFILE="openbao"
```

## src/main.c
```c
/*
 * Copyright (c) 2026 Romain Pelletant
 *
 * SPDX-License-Identifier: Apache-2.0
 */

#include <stdio.h>

int main(void)
{
	printf("zkeyring demo firmware %s\n", CONFIG_MCUBOOT_IMGTOOL_SIGN_VERSION);

	return 0;
}
```
