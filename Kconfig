## Kconfig
```kconfig
# SPDX-License-Identifier: Apache-2.0
# Copyright 2026 Romain Pelletant

config ZSIGNING
	bool "Sign MCUboot firmware with zkeyring"
	depends on BOOTLOADER_MCUBOOT
	help
	  Export the MCUboot image parameters and public key, then run
	  zkeyring sign as part of the build.

config ZSIGNING_DEFERRED
	bool "Defer zkeyring signing to a separate step"
	depends on ZSIGNING
	help
	  Export the unsigned image and signing metadata for a separate
	  west zkeyring sign invocation in an environment with backend access.

config ZSIGNING_PROFILE_FILE
	string "zkeyring signing profile file"
	depends on ZSIGNING
	default "zkeyring.yaml"
	help
	  Path to the YAML profile file used during the build. Relative
	  paths are resolved against the application source directory.
	  The ZKEYRING_CONFIG CMake variable can override this path.

config ZSIGNING_PROFILE
	string "zkeyring signing profile"
	depends on ZSIGNING
	default "default"
	help
	  Name of the profile used for signing during the build. The
	  ZKEYRING_PROFILE CMake variable can override this name.
```

## sysbuild/Kconfig
```kconfig
# SPDX-License-Identifier: Apache-2.0

choice ZKEYRING_SIGNATURE_TYPE
	prompt "Firmware signature algorithm"
	depends on BOOTLOADER_MCUBOOT
	default ZKEYRING_SIGNATURE_INHERIT
	help
	  Set the signature algorithm that MCUboot verifies. The public key in
	  the selected zkeyring profile must match this algorithm.

config ZKEYRING_SIGNATURE_INHERIT
	bool "Use the MCUboot Sysbuild setting"

config ZKEYRING_SIGNATURE_ECDSA_P256
	bool "ECDSA P-256"

config ZKEYRING_SIGNATURE_RSA_2048
	bool "RSA-PSS 2048"

config ZKEYRING_SIGNATURE_RSA_3072
	bool "RSA-PSS 3072"

config ZKEYRING_SIGNATURE_ED25519
	bool "Ed25519"

endchoice

config ZKEYRING_PROFILE_PUBLIC_KEY
	bool "Use the zkeyring profile's public key in MCUboot"
	depends on BOOTLOADER_MCUBOOT && (!BOOT_SIGNATURE_TYPE_NONE || !ZKEYRING_SIGNATURE_INHERIT)
	help
	  Let the main application provide MCUboot's primary verification key.
	  Select a zkeyring profile with CONFIG_ZSIGNING_PROFILE and set its
	  public_key and fingerprint fields. A profile without public_key
	  uses the configured MCUboot signing public key.
```
